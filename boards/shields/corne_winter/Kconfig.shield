## boards/shields/corne_winter/Kconfig.shield
```kconfig
config SHIELD_CORNE_WINTER_LEFT
    def_bool $(shields_list_contains,corne_winter_left)
  
config SHIELD_CORNE_WINTER_RIGHT
    def_bool $(shields_list_contains,corne_winter_right)
  
config SHIELD_CORNE_WINTER_DONGLE
    def_bool $(shields_list_contains,corne_winter_dongle)
```
